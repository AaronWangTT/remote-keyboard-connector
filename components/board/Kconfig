## components/board/Kconfig
```kconfig
menu "Board controls"

choice BOARD_STATUS_PROFILE
    prompt "Board profile"
    default BOARD_STATUS_LED_DISABLED

config BOARD_STATUS_LED_DISABLED
    bool "Disabled / unspecified board (leave GPIO untouched)"

config BOARD_XINLUCITY_ESP32S3_NANO
    bool "XinluCity ESP32S3 NANO / ESP32-S3-N16R8 (G48 active-low)"
    depends on IDF_TARGET_ESP32S3
    help
        Select only for the documented single-color G48 circuit on this
        board. GPIO48 LOW illuminates the LED; HIGH turns it off.
        This does not control PWR or configure flash/PSRAM capacity.

config BOARD_SEEED_XIAO_ESP32S3
    bool "Seeed Studio XIAO ESP32S3 (8 MiB flash)"
    depends on IDF_TARGET_ESP32S3
    help
        Select only for the standard XIAO ESP32S3, not the 16 MiB Plus.
        Use the tracked XIAO defaults overlay for its flash and OTA layout.
        The GPIO21 user LED is active-low. Automatic deep sleep is available
        with GPIO0 BOOT wake but defaults to Never until the owner opts in.
        The battery-charge LED is independent and is not software-controlled.

endchoice

config BOARD_POWER_MANAGEMENT
    bool "Automatic deep sleep with BOOT wake"
    depends on (BOARD_XINLUCITY_ESP32S3_NANO || BOARD_SEEED_XIAO_ESP32S3) && IDF_TARGET_ESP32S3
    default y
    help
        Enable GPIO0 BOOT wake on the selected board. The status LED stays off
        during sleep. Both boards default to Never until the owner opts in.
        The owner can save 30 minutes, 60 minutes, or Never on either board.
        Fixed power/charge indicators remain independent.
        Physical power, USB reconnection and wake acceptance are still required.

endmenu
```

## components/firmware_update/Kconfig.projbuild
```kconfig
menu "Keyboard firmware updates"
    config KEYBOARD_RELEASE
        bool "Build a trusted release (requires an external signing key)"
        default n
endmenu
```

## components/network/Kconfig
```kconfig
menu "Wi-Fi keyboard networking"

    config NETWORK_DEFAULT_HOSTNAME
        string
        default "x" if BOARD_SEEED_XIAO_ESP32S3
        default "kb"
        help
            Initial mDNS hostname, without .local. Saved owner-selected names
            take precedence. Packaged board profiles use x or kb.

    config KEYBOARD_HTTP_DEVELOPMENT
        bool "Allow authenticated HTTP/WS for isolated development"
        default n
        help
            Requires unique sender-provisioned AP and owner setup credentials.
            HTTP/WS does not protect credentials or input against interception.
            Use only on protected personal test networks with non-sensitive hosts.

endmenu
```

## sdkconfig.defaults
```kconfig
CONFIG_IDF_TARGET="esp32s3"
CONFIG_COMPILER_OPTIMIZATION_SIZE=y
CONFIG_ESPTOOLPY_FLASHSIZE_16MB=y
CONFIG_PARTITION_TABLE_CUSTOM=y
CONFIG_PARTITION_TABLE_CUSTOM_FILENAME="partitions.csv"
CONFIG_ESP_PHY_INIT_DATA_IN_PARTITION=n
CONFIG_ESP_PHY_CALIBRATION_AND_DATA_STORAGE=y
CONFIG_SECURE_SIGNED_APPS_NO_SECURE_BOOT=y
CONFIG_SECURE_SIGNED_APPS_RSA_SCHEME=y
CONFIG_SECURE_SIGNED_ON_UPDATE_NO_SECURE_BOOT=y
CONFIG_SECURE_BOOT_BUILD_SIGNED_BINARIES=y
CONFIG_SECURE_BOOT_SIGNING_KEY=".cache/ota-test-signing-key.pem"
CONFIG_BOOTLOADER_APP_ROLLBACK_ENABLE=y
CONFIG_BOOTLOADER_WDT_ENABLE=y
CONFIG_BOOTLOADER_WDT_DISABLE_IN_USER_CODE=y
CONFIG_BOOTLOADER_WDT_TIME_MS=60000
CONFIG_APP_COMPILE_TIME_DATE=n
CONFIG_KEYBOARD_HTTP_DEVELOPMENT=y
CONFIG_TINYUSB_HID_COUNT=1
CONFIG_HTTPD_WS_SUPPORT=y
CONFIG_HTTPD_WS_PRE_HANDSHAKE_CB_SUPPORT=y
```
